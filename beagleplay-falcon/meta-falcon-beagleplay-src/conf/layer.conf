## beagleplay-falcon/meta-falcon-beagleplay-src/conf/layer.conf
```bitbake
BBPATH .= ":${LAYERDIR}"
BBFILES += "${LAYERDIR}/recipes-*/*/*.bbappend"
BBFILE_COLLECTIONS += "falcon-beagleplay"
BBFILE_PATTERN_falcon-beagleplay = "^${LAYERDIR}/"
BBFILE_PRIORITY_falcon-beagleplay = "10"
LAYERSERIES_COMPAT_falcon-beagleplay = "scarthgap"
```

## beagley-ai/meta-ultima-beagley-ai-src/conf/layer.conf
```bitbake
BBPATH .= ":${LAYERDIR}"
BBFILES += "${LAYERDIR}/recipes-*/*/*.bb ${LAYERDIR}/recipes-*/*/*.bbappend"
BBFILE_COLLECTIONS += "ultima-beagley-ai"
BBFILE_PATTERN_ultima-beagley-ai = "^${LAYERDIR}/"
BBFILE_PRIORITY_ultima-beagley-ai = "10"
LAYERSERIES_COMPAT_ultima-beagley-ai = "scarthgap"
LAYERDEPENDS_ultima-beagley-ai = "core qt5-layer"
```
