## br2-external/configs/ultima_rpi5_defconfig
```kconfig
# Architecture
BR2_aarch64=y
BR2_cortex_a76=y

# Kernel headers (must come before toolchain C library selection)
BR2_KERNEL_HEADERS_6_6=y

# Toolchain
BR2_TOOLCHAIN_BUILDROOT_GLIBC=y
BR2_TOOLCHAIN_BUILDROOT_CXX=y
BR2_TOOLCHAIN_BUILDROOT_WCHAR=y

# Device management - eudev for /dev/input nodes
BR2_ROOTFS_DEVICE_CREATION_DYNAMIC_EUDEV=y

# Init system - BusyBox for fast boot
BR2_INIT_BUSYBOX=y

# Kernel
BR2_LINUX_KERNEL=y
BR2_LINUX_KERNEL_CUSTOM_TARBALL=y
BR2_LINUX_KERNEL_CUSTOM_TARBALL_LOCATION="https://github.com/raspberrypi/linux/archive/rpi-6.6.y.tar.gz"
BR2_LINUX_KERNEL_DEFCONFIG="bcm2712"
BR2_LINUX_KERNEL_DTS_SUPPORT=y
BR2_LINUX_KERNEL_INTREE_DTS_NAME="broadcom/bcm2712-rpi-5-b"
BR2_LINUX_KERNEL_NEEDS_HOST_OPENSSL=y

# Kernel modules needed
BR2_LINUX_KERNEL_CONFIG_FRAGMENT_FILES="$(BR2_EXTERNAL_ULTIMA_PATH)/board/ultima-rpi5/kernel-fragments.cfg"

# Bootloader / firmware
BR2_PACKAGE_RPI_FIRMWARE=y
BR2_PACKAGE_RPI_FIRMWARE_VARIANT_PI4_64=y

# Filesystem
BR2_TARGET_ROOTFS_EXT2=y
BR2_TARGET_ROOTFS_EXT2_4=y
BR2_TARGET_ROOTFS_EXT2_SIZE="320M"
BR2_ROOTFS_OVERLAY="$(BR2_EXTERNAL_ULTIMA_PATH)/board/ultima-rpi5/overlay"
BR2_ROOTFS_POST_BUILD_SCRIPT="$(BR2_EXTERNAL_ULTIMA_PATH)/board/ultima-rpi5/post-build.sh"
BR2_ROOTFS_POST_IMAGE_SCRIPT="$(BR2_EXTERNAL_ULTIMA_PATH)/board/ultima-rpi5/post-image.sh"

# Image generation
BR2_PACKAGE_HOST_GENIMAGE=y
BR2_PACKAGE_HOST_DOSFSTOOLS=y
BR2_PACKAGE_HOST_MTOOLS=y

# Qt5
BR2_PACKAGE_QT5=y
BR2_PACKAGE_QT5BASE=y
BR2_PACKAGE_QT5BASE_OPENGL_LIB=y
BR2_PACKAGE_QT5BASE_PNG=y
BR2_PACKAGE_QT5BASE_EGLFS=y
BR2_PACKAGE_QT5BASE_FONTCONFIG=y
BR2_PACKAGE_QT5BASE_DEFAULT_QPA="eglfs"
BR2_PACKAGE_QT5DECLARATIVE=y
BR2_PACKAGE_QT5DECLARATIVE_QUICK=y

# Graphics - Mesa for V3D (RPi5)
BR2_PACKAGE_MESA3D=y
BR2_PACKAGE_MESA3D_GALLIUM_DRIVER_V3D=y
BR2_PACKAGE_MESA3D_GALLIUM_DRIVER_VC4=y
BR2_PACKAGE_MESA3D_OPENGL_EGL=y
BR2_PACKAGE_MESA3D_OPENGL_ES=y
BR2_PACKAGE_LIBDRM=y

# Input - touch support
BR2_PACKAGE_LIBINPUT=y
BR2_PACKAGE_EVTEST=y

# WiFi
BR2_PACKAGE_WPA_SUPPLICANT=y
BR2_PACKAGE_WPA_SUPPLICANT_NL80211=y
BR2_PACKAGE_WPA_SUPPLICANT_AUTOSCAN=y
BR2_PACKAGE_LINUX_FIRMWARE=y
BR2_PACKAGE_LINUX_FIRMWARE_BRCM_BCM43XX=y

# Networking
BR2_PACKAGE_DHCPCD=y
BR2_PACKAGE_IPROUTE2=y

# Fonts
BR2_PACKAGE_DEJAVU=y

# Utilities
BR2_PACKAGE_NANO=y
BR2_PACKAGE_DROPBEAR=y

# System
BR2_TARGET_GENERIC_HOSTNAME="ultima"
BR2_TARGET_GENERIC_ISSUE="Ultima RPi5"
BR2_TARGET_GENERIC_GETTY_PORT="ttyAMA10"
BR2_TARGET_GENERIC_GETTY_BAUDRATE_115200=y
BR2_SYSTEM_DHCP="wlan0"

# Ultima app package
BR2_PACKAGE_ULTIMA_APP=y

# Strip for size
BR2_STRIP_strip=y
BR2_OPTIMIZE_S=y
BR2_ENABLE_LOCALE_PURGE=y
```

## br2-external/package/ultima-app/Config.in
```kconfig
config BR2_PACKAGE_ULTIMA_APP
	bool "ultima-app"
	depends on BR2_PACKAGE_QT5BASE
	depends on BR2_PACKAGE_QT5DECLARATIVE
	help
	  Ultima fullscreen Qt5 QML application.
	  Displays a hello world greeting and live clock.
```
